## conf/bblayers.conf
```bitbake
# POKY_BBLAYERS_CONF_VERSION is increased each time build/conf/bblayers.conf
# changes incompatibly
POKY_BBLAYERS_CONF_VERSION = "2"

BBPATH = "${TOPDIR}"
ROOTPATH = "${PWD}/../.."
BBFILES ?= ""

BBLAYERS ?= " \
    ${ROOTPATH}/poky-morty/meta \
    ${ROOTPATH}/poky-morty/meta-poky \
    ${ROOTPATH}/poky-morty/meta-openembedded/meta-oe \
    ${ROOTPATH}/poky-morty/meta-openembedded/meta-multimedia \
    ${ROOTPATH}/poky-morty/meta-openembedded/meta-networking \
    ${ROOTPATH}/poky-morty/meta-openembedded/meta-python \
    ${ROOTPATH}/poky-morty/meta-qt5 \
    ${ROOTPATH}/poky-morty/meta-raspberrypi \
	    ${ROOTPATH}/rpi/meta-rpi \
  "
```
